## components/esp_ot_cli_extension/Kconfig
```kconfig
menu "OpenThread Extension CLI"

    menuconfig OPENTHREAD_CLI_ESP_EXTENSION
        depends on OPENTHREAD_FTD || OPENTHREAD_MTD
        bool "Enable Espressif's extended features"
        default y
        help
            Enable Espressif's extended features.

    config OPENTHREAD_CLI_WIFI
        bool "Enable wifi connection command"
        depends on OPENTHREAD_CLI_ESP_EXTENSION && OPENTHREAD_BORDER_ROUTER && EXAMPLE_CONNECT_WIFI
        default y if ESP_WIFI_ENABLED || ESP_WIFI_REMOTE_ENABLED

    config OPENTHREAD_CLI_OTA
        bool "Enable OTA command"
        depends on OPENTHREAD_CLI_ESP_EXTENSION && OPENTHREAD_BORDER_ROUTER
        default n

    config OPENTHREAD_NVS_DIAG
        bool "Enable nvs diag"
        depends on OPENTHREAD_CLI_ESP_EXTENSION
        default n

    config OPENTHREAD_RCP_COMMAND
        bool "Enable rcp control command of border router"
        depends on OPENTHREAD_CLI_ESP_EXTENSION && OPENTHREAD_BORDER_ROUTER && AUTO_UPDATE_RCP
        default y if AUTO_UPDATE_RCP

    config OPENTHREAD_BR_LIB_CHECK
        bool "Enable br lib compatibility check command, only for testing"
        depends on OPENTHREAD_CLI_ESP_EXTENSION && OPENTHREAD_BORDER_ROUTER
        default n

endmenu
```

## components/esp_rcp_update/Kconfig
```kconfig
menu "OpenThread RCP Update"

    config AUTO_UPDATE_RCP
        bool 'Update RCP automatically'
        default y
        help
            If enabled, the device will store the RCP image in its firmware and
            compare the stored image version with the running RCP image upon boot. The RCP
            will be automatically updated upon version mismatch.

    config CREATE_OTA_IMAGE_WITH_RCP_FW
        bool 'Create the OTA image with rcp for border router'
        default n
        help
            If enabled, an ota image will be generated during building.

endmenu
```

## examples/basic_thread_border_router/main/Kconfig.projbuild
```kconfig
menu "OpenThread Border Router Example"

    config PIN_TO_RCP_RESET
        depends on !BR_BOARD_DEV_KIT
        string "Pin to RCP reset"
        default "4"

    config PIN_TO_RCP_BOOT
        depends on !BR_BOARD_DEV_KIT
        string "Pin to RCP boot"
        default "5"

    config PIN_TO_RCP_TX
        depends on !BR_BOARD_DEV_KIT
        string "Pin to RCP TX"
        default "17"

    config PIN_TO_RCP_RX
        depends on !BR_BOARD_DEV_KIT
        string "Pin to RCP RX"
        default "18"

endmenu
```

## examples/basic_thread_border_router/sdkconfig.defaults
```kconfig
# ESP32-S3 is the host SoC on ESP-Thread-Border-Router board
CONFIG_IDF_TARGET="esp32s3"

#
# Serial flasher config
#
CONFIG_ESPTOOLPY_FLASHSIZE_4MB=y
# end of Serial flasher config

#
# Partition Table
#
CONFIG_PARTITION_TABLE_CUSTOM=y
CONFIG_PARTITION_TABLE_CUSTOM_FILENAME="partitions.csv"
CONFIG_PARTITION_TABLE_FILENAME="partitions.csv"
CONFIG_PARTITION_TABLE_OFFSET=0x8000
CONFIG_PARTITION_TABLE_MD5=y
# end of Partition Table

#
# Compiler options
#
CONFIG_COMPILER_OPTIMIZATION_SIZE=y

#
# Newlib
#
CONFIG_NEWLIB_NANO_FORMAT=y

#
# mbedTLS
#

CONFIG_MBEDTLS_CMAC_C=y
CONFIG_MBEDTLS_SSL_PROTO_DTLS=y
CONFIG_MBEDTLS_KEY_EXCHANGE_ECJPAKE=y
# end of TLS Key Exchange Methods

CONFIG_MBEDTLS_ECJPAKE_C=y
# end of mbedTLS

#
# OpenThread
#
CONFIG_OPENTHREAD_ENABLED=y
CONFIG_OPENTHREAD_BORDER_ROUTER=y
CONFIG_OPENTHREAD_CLI_OTA=y
CONFIG_OPENTHREAD_RCP_COMMAND=y
CONFIG_OPENTHREAD_RADIO_SPINEL_UART=y
# end of OpenThread

#
# OpenThread Border Router Example
#
CONFIG_AUTO_UPDATE_RCP=y
# end of OpenThread Border Router Example

#
# lwIP
#
CONFIG_LWIP_IPV6_FORWARD=y

# Use 12 with IDF v5.3.1 and later, and use 8 with earlier versions of IDF.
CONFIG_LWIP_IPV6_NUM_ADDRESSES=12

CONFIG_LWIP_MULTICAST_PING=y
CONFIG_LWIP_NETIF_STATUS_CALLBACK=y
CONFIG_LWIP_HOOK_IP6_ROUTE_DEFAULT=y
CONFIG_LWIP_HOOK_ND6_GET_GW_DEFAULT=y
CONFIG_LWIP_HOOK_IP6_INPUT_CUSTOM=y
CONFIG_LWIP_IPV6_AUTOCONFIG=y
CONFIG_LWIP_HOOK_IP6_SELECT_SRC_ADDR_CUSTOM=y
CONFIG_LWIP_FORCE_ROUTER_FORWARDING=y
# end of lwIP

#
# mDNS
#
CONFIG_MDNS_MULTIPLE_INSTANCE=y
CONFIG_MDNS_MAX_SERVICES=200
# end of mDNS

#
# ESP System Settings
#
CONFIG_ESP_SYSTEM_EVENT_TASK_STACK_SIZE=3584
# end of ESP System Settings

#
# ESP Border Router Board Kit
#
CONFIG_ESP_BR_BOARD_DEV_KIT=y
CONFIG_ESP_CONSOLE_USB_SERIAL_JTAG=y
# end of ESP Border Router Board Kit

#
# Ethernet
# 
CONFIG_EXAMPLE_USE_W5500=y
CONFIG_EXAMPLE_ETH_SPI_HOST=2
CONFIG_EXAMPLE_ETH_SPI_SCLK_GPIO=21
CONFIG_EXAMPLE_ETH_SPI_MOSI_GPIO=45
CONFIG_EXAMPLE_ETH_SPI_MISO_GPIO=38
CONFIG_EXAMPLE_ETH_SPI_CS_GPIO=41
CONFIG_EXAMPLE_ETH_SPI_CLOCK_MHZ=36
CONFIG_EXAMPLE_ETH_SPI_INT_GPIO=39
CONFIG_EXAMPLE_ETH_PHY_RST_GPIO=40
CONFIG_EXAMPLE_ETH_PHY_ADDR=1
# end of Etherenet
```

## examples/basic_thread_border_router/sdkconfig.defaults.esp32p4
```kconfig
CONFIG_PIN_TO_RCP_TX=4
CONFIG_PIN_TO_RCP_RX=5

CONFIG_ESP_BR_BOARD_STANDALONE=y
CONFIG_ESP_CONSOLE_UART_DEFAULT=y

CONFIG_OPENTHREAD_BR_AUTO_START=y
CONFIG_LWIP_PPP_SUPPORT=y
CONFIG_LWIP_PPP_SERVER_SUPPORT=y

CONFIG_EXAMPLE_USE_INTERNAL_ETHERNET=y
CONFIG_ESP_BR_C6_TARGET=y
```

## examples/basic_thread_border_router/sdkconfig.defaults.esp32s3
```kconfig
# specific configuration for ESP Thread Border Router Board

CONFIG_BR_BOARD_DEV_KIT=y

CONFIG_ESP_CONSOLE_USB_SERIAL_JTAG=y
```

## examples/common/border_router_board/Kconfig
```kconfig
menu "ESP Border Router Board"

    choice ESP_BR_BOARD_TYPE
        prompt "Border router board type"
        default ESP_BR_BOARD_STANDALONE
        help
            The board running the border router.

        config ESP_BR_BOARD_STANDALONE
            bool "Standalone dev kits"
            help
                Standalone ESP Wi-Fi dev kit manually connected to the RCP

        config ESP_BR_BOARD_DEV_KIT
            bool "Border router dev kit"
            help
                Integrated border router dev kit
    endchoice

endmenu
```

## examples/common/thread_border_router/Kconfig.projbuild
```kconfig
menu "ESP Thread Border Router Example"

    choice ESP_BR_BOARD_TYPE
        prompt "Border router board type"
        default ESP_BR_BOARD_STANDALONE
        help
            The board running the border router.

        config ESP_BR_BOARD_STANDALONE
            bool "Standalone dev kits"
            help
                Standalone ESP Wi-Fi dev kit manually connected to the RCP

        config ESP_BR_BOARD_DEV_KIT
            bool "Border router dev kit"
            help
                Integrated border router dev kit

        config ESP_BR_BOARD_P4
            bool "ESP32-P4-Function-EV-Board"
            help
                P4 main processor (Ethernet) + C6 Thread radio co-processor

        config ESP_BR_BOARD_M5STACK_CORES3
            bool "Border router M5Stack CoreS3"
            help
                M5Stack CoreS3
    endchoice

    menu "Board Configuration"
        config PIN_TO_RCP_RESET
            int "Pin to RCP reset"
            default 7 if ESP_BR_BOARD_DEV_KIT
            default 7 if ESP_BR_BOARD_P4
            default 7 if ESP_BR_BOARD_M5STACK_CORES3

        config PIN_TO_RCP_BOOT
            int "Pin to RCP boot"
            default 8 if ESP_BR_BOARD_DEV_KIT
            default 8 if ESP_BR_BOARD_P4
            default 18 if ESP_BR_BOARD_M5STACK_CORES3

        config PIN_TO_RCP_TX
            int "Pin to RCP TX"
            default 17 if ESP_BR_BOARD_DEV_KIT
            default 4 if ESP_BR_BOARD_P4
            default 10 if ESP_BR_BOARD_M5STACK_CORES3

        config PIN_TO_RCP_RX
            int "Pin to RCP RX"
            default 18 if ESP_BR_BOARD_DEV_KIT
            default 5 if ESP_BR_BOARD_P4
            default 17 if ESP_BR_BOARD_M5STACK_CORES3

        config PIN_TO_RCP_CS
            depends on OPENTHREAD_RADIO_SPINEL_SPI
            int "Pin to RCP SPI CS"
            default 10 if ESP_BR_BOARD_DEV_KIT
            default 20 if ESP_BR_BOARD_P4
            default 13 if ESP_BR_BOARD_M5STACK_CORES3

        config PIN_TO_RCP_SCLK
            depends on OPENTHREAD_RADIO_SPINEL_SPI
            int "Pin to RCP SPI SCLK"
            default 12 if ESP_BR_BOARD_DEV_KIT
            default 22 if ESP_BR_BOARD_P4
            default 36 if ESP_BR_BOARD_M5STACK_CORES3

        config PIN_TO_RCP_MISO
            depends on OPENTHREAD_RADIO_SPINEL_SPI
            int "Pin to RCP SPI MISO"
            default 13 if ESP_BR_BOARD_DEV_KIT
            default 23 if ESP_BR_BOARD_P4
            default 35 if ESP_BR_BOARD_M5STACK_CORES3

        config PIN_TO_RCP_MOSI
            depends on OPENTHREAD_RADIO_SPINEL_SPI
            int "Pin to RCP SPI MOSI"
            default 11 if ESP_BR_BOARD_DEV_KIT
            default 21 if ESP_BR_BOARD_P4
            default 37 if ESP_BR_BOARD_M5STACK_CORES3
    endmenu

    choice ESP_BR_RCP_TARGET
        prompt "Border router RCP target"
        default ESP_BR_H2_TARGET
        help
            The board running the Thread RCP.

        config ESP_BR_H2_TARGET
            bool "ESP32-H2"
            help
                ESP32-H2 RCP 

        config ESP_BR_C6_TARGET
            bool "ESP32-C6"
            help
                ESP32-C6 RCP
    endchoice

    config OPENTHREAD_BR_AUTO_START
        bool 'Enable the automatic start mode in Thread Border Router.'
        default n
        help
            If enabled, The Thread Border Router will connect to Wi-Fi with pre-configured
            SSID and PSK, and then form a Thread network automatically. Otherwise, user need
            to configure Wi-Fi and Thread manually.

    config OPENTHREAD_BR_START_WEB
        bool 'Enable the web server in Thread Border Router.'
        select OPENTHREAD_COMMISSIONER
        select OPENTHREAD_JOINER
        default n
        help
            If enabled, a web server will be provided to configure and query Thread network via a Web GUI.

    config OPENTHREAD_BR_SOFTAP_SETUP
        bool 'Enable SoftAP Wi-Fi configuration mode'
        default n
        help
            If enabled, the border router will start a SoftAP (Access Point) mode when no Wi-Fi
            credentials are found or WiFi connection fails. Users can connect to the AP and
            configure Wi-Fi via a web interface at http://192.168.4.1.

endmenu
```

## examples/common/thread_border_router_m5stack/Kconfig.projbuild
```kconfig
menu "ESP Thread Border Router M5Stack Example"

    choice RADIO_CO_PROCESSOR_MODE
        prompt "IEEE 802.15.4 Radio Co-Processor Mode"
        default RADIO_CO_PROCESSOR_MODULE_H2
        help
            Select the target hardware configuration for the IEEE 802.15.4 Radio Co-Processor.

        config RADIO_CO_PROCESSOR_MODULE_H2
            bool "Module Gateway H2"
            help
                Select this if you are using a Module Gateway H2.

        config RADIO_CO_PROCESSOR_UNIT_H2
            bool "Unit Gateway H2"
            help
                Select this if you are using a Unit Gateway H2, the following must be ensured:
                    1. Connect the CoreS3 and Module Gateway H2 via PORT C.
                    2. Disable the AUTO_UPDATE_RCP feature.
                    3. Set PIN_TO_RCP_TX to 18 and PIN_TO_RCP_RX to 17.
    endchoice # RADIO_CO_PROCESSOR_MODE

    menu "Thread Ephemeral Key Configurations"
        config OPENTHREAD_EPHEMERALKEY_LIFE_TIME
            int "The life time (seconds) of openthread ephemeral key"
            default 100
            help
                Set the lifetime of the OpenThread ephemeral key in seconds.

        config OPENTHREAD_EPHEMERALKEY_PORT
            int "The UDP port to use with the ephemeral key"
            default 49180
            help
                Set the UDP port to use with the ephemeral key.

    endmenu

endmenu
```

## examples/m5stack_thread_border_router/sdkconfig.defaults
```kconfig
# ESP32-S3 is the host SoC on ESP-Thread-Border-Router board
CONFIG_IDF_TARGET="esp32s3"

#
# Serial flasher config
#
CONFIG_ESPTOOLPY_FLASHSIZE_16MB=y
# end of Serial flasher config

#
# Partition Table
#
CONFIG_PARTITION_TABLE_CUSTOM=y
CONFIG_PARTITION_TABLE_CUSTOM_FILENAME="partitions.csv"
CONFIG_PARTITION_TABLE_FILENAME="partitions.csv"
CONFIG_PARTITION_TABLE_OFFSET=0x8000
CONFIG_PARTITION_TABLE_MD5=y
# end of Partition Table

#
# Compiler options
#
CONFIG_COMPILER_OPTIMIZATION_SIZE=y

#
# Newlib
#
CONFIG_NEWLIB_NANO_FORMAT=y

#
# mbedTLS
#

CONFIG_MBEDTLS_CMAC_C=y
CONFIG_MBEDTLS_SSL_PROTO_DTLS=y
CONFIG_MBEDTLS_KEY_EXCHANGE_ECJPAKE=y
# end of TLS Key Exchange Methods

CONFIG_MBEDTLS_ECJPAKE_C=y
# end of mbedTLS

#
# OpenThread
#
CONFIG_OPENTHREAD_ENABLED=y
CONFIG_OPENTHREAD_BORDER_ROUTER=y
CONFIG_OPENTHREAD_CLI_OTA=y
CONFIG_OPENTHREAD_RCP_COMMAND=y
CONFIG_OPENTHREAD_CONSOLE_TYPE_USB_SERIAL_JTAG=y
CONFIG_OPENTHREAD_RADIO_SPINEL_UART=y
CONFIG_OPENTHREAD_PLATFORM_MSGPOOL_MANAGEMENT=y
# end of OpenThread

#
# OpenThread Border Router Example
#
CONFIG_AUTO_UPDATE_RCP=y
CONFIG_OPENTHREAD_BR_START_WEB=y
CONFIG_ESP_BR_BOARD_M5STACK_CORES3=y
CONFIG_OPENTHREAD_BR_AUTO_START=y
# end of OpenThread Border Router Example

#
# lwIP
#
CONFIG_LWIP_IPV6_FORWARD=y

# Use 12 with IDF v5.3.1 and later, and use 8 with earlier versions of IDF.
CONFIG_LWIP_IPV6_NUM_ADDRESSES=12

CONFIG_LWIP_MULTICAST_PING=y
CONFIG_LWIP_NETIF_STATUS_CALLBACK=y
CONFIG_LWIP_HOOK_IP6_ROUTE_DEFAULT=y
CONFIG_LWIP_HOOK_ND6_GET_GW_DEFAULT=y
CONFIG_LWIP_HOOK_IP6_INPUT_CUSTOM=y
CONFIG_LWIP_IPV6_AUTOCONFIG=y
CONFIG_LWIP_HOOK_IP6_SELECT_SRC_ADDR_CUSTOM=y
CONFIG_LWIP_FORCE_ROUTER_FORWARDING=y
# end of lwIP

#
# mDNS
#
CONFIG_MDNS_MULTIPLE_INSTANCE=y
CONFIG_MDNS_ACTION_QUEUE_LEN=64
# end of mDNS

#
# ESP System Settings
#
CONFIG_ESP_SYSTEM_EVENT_TASK_STACK_SIZE=3584
# end of ESP System Settings

#
# Channel for console output
#
CONFIG_ESP_CONSOLE_USB_SERIAL_JTAG=y

#
# SPIRAM
#
CONFIG_SPIRAM=y
CONFIG_SPIRAM_TRY_ALLOCATE_WIFI_LWIP=y

#
# LVGL
#
CONFIG_LV_FONT_MONTSERRAT_12=y
CONFIG_LV_FONT_MONTSERRAT_16=y
CONFIG_LV_FONT_MONTSERRAT_18=y
CONFIG_LV_FONT_MONTSERRAT_20=y
CONFIG_LV_FONT_MONTSERRAT_24=y
CONFIG_LV_FONT_MONTSERRAT_26=y
CONFIG_LV_FONT_MONTSERRAT_28=y
CONFIG_LV_FONT_MONTSERRAT_20=y
CONFIG_LV_FONT_MONTSERRAT_32=y
CONFIG_LV_FONT_MONTSERRAT_48=y
CONFIG_LV_COLOR_16_SWAP=y
CONFIG_LV_MEM_CUSTOM=y
```
