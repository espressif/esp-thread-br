## examples/basic_thread_border_router/sdkconfig.defaults.4mb
```kconfig
CONFIG_ESPTOOLPY_FLASHSIZE_4MB=y
CONFIG_PARTITION_TABLE_CUSTOM_FILENAME="partitions_4mb.csv"
CONFIG_PARTITION_TABLE_FILENAME="partitions_4mb.csv"
CONFIG_OPENTHREAD_CLI_OTA=n
CONFIG_CREATE_OTA_IMAGE_WITH_RCP_FW=n
```
